/**************dis_12864.c***************/

#include <p_12864.h>

/*******************************************************************/                                                    
//  延时函数                                                                                                                  
/*******************************************************************/
void delay(int ms)
{
    while(ms--)
{
      uchar i;
 for(i=0;i<250;i++)  
  {
   ; ; ; ;
  }
}
}
/*******************************************************************/                                                         
/*检查LCD忙状态                                                    */
/*lcd_busy为1时，忙，等待。lcd-busy为0时,闲，可写指令与数据。      */                                                          
/*******************************************************************/ 
bit lcd_busy()
 {                          
    bit result;
    LCD_RS = 0;
    LCD_RW = 1;
    LCD_EN = 1;
     delay(1);
    result = (bit)(LCD_data&0x80);
    LCD_EN = 0;
    return(result); 
 }
/*******************************************************************/                                                               
/*写指令数据到LCD                                                  */
/*RS=L，RW=L，E=高脉冲，D0-D7=指令码。                             */                                                                
/*******************************************************************/
void lcd_wcmd(uchar cmd)
{                          
   while(lcd_busy());
    LCD_RS = 0;
    LCD_RW = 0;
    LCD_EN = 0;
    delay(1);
    LCD_data = cmd;
   delay(1);
    LCD_EN = 1;
   delay(1);
    LCD_EN = 0;  
}
/*******************************************************************/
/*写显示数据到LCD                                                  */
/*RS=H，RW=L，E=高脉冲，D0-D7=数据。                               */
/*******************************************************************/
void lcd_wdat(uchar dat)
{                          
   while(lcd_busy());
    LCD_RS = 1;
    LCD_RW = 0;
    LCD_EN = 0;
    LCD_data = dat;
   delay(1);
    LCD_EN = 1;
  delay(1);
    LCD_EN = 0; 
}
/*******************************************************************/
/*  LCD初始化设定                                                  */
/*******************************************************************/
void lcd_init()
{ 


    LCD_PSB = 1;         //并口方式
    
    lcd_wcmd(0x34);      //扩充指令操作
    delay(5);
    lcd_wcmd(0x30);      //基本指令操作
    delay(5);
    lcd_wcmd(0x0C);      //显示开，关光标
    delay(5);
    lcd_wcmd(0x01);      //清除LCD的显示内容
    delay(5);
}


/*********************************************************/
/* 设定显示位置       X:行数                Y：列数                                   */
/*********************************************************/
void lcd_pos(uchar X,uchar Y)
{                          
   uchar  pos;
   if (X==0)
     {X=0x80;}
   else if (X==1)
     {X=0x90;}
   else if (X==2)
     {X=0x88;}
   else if (X==3)
     {X=0x98;}
   pos = X+Y ;  
   lcd_wcmd(pos);     //显示地址
}

/*********************************************************/
/* 在设定位置显示字符（串）                                         */
/*********************************************************/
void zifu_dis (uchar X,uchar Y,uchar *dis)
{
    uchar i;
lcd_pos(X,Y);  
     i = 0;
    while(dis[i] != '\0')
     {                         //显示字符
       lcd_wdat(dis[i]);
       i++;
     }
}